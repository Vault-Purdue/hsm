/**
 * @cliArgs --device "MSPM0L222X" --part "Default" --package "LQFP-80(PN)" --product "mspm0_sdk@2.10.00.04"
 * @versions {"tool":"1.27.0+4565"}
 */

/**
 * Import the modules used in this configuration.
 */
const Board         = scripting.addModule("/ti/driverlib/Board");
const NONMAIN       = scripting.addModule("/ti/driverlib/NONMAIN");
const SECCONFIG     = scripting.addModule("/ti/driverlib/SECCONFIG");
const ProjectConfig = scripting.addModule("/ti/project_config/ProjectConfig");

/**
 * Write custom configuration values to the imported modules.
 */

NONMAIN.nonmainWarning = true;
NONMAIN.cscExists      = true;

SECCONFIG.cscPrereqAck                = true;
SECCONFIG.enableCMACAcceleration      = false;
SECCONFIG.enableRollbackProtection    = false;
SECCONFIG.enableStaticSharedSecretKey = false;
SECCONFIG.enableIPProtection          = false;
SECCONFIG.exposeSecurityPrimitives    = false;
SECCONFIG.cscSecretAddress            = 0x4000;
SECCONFIG.cscSecretSize               = 1024;
SECCONFIG.cscLockStorageSize          = 1024;

ProjectConfig.deviceSpin = "MSPM0L2228";
ProjectConfig.genLinker  = false;

/**
 * These are the reserved peripherals and settings in this configuration
 */
const TRNG1   = scripting.addPeripheral("TRNG");
TRNG1.$name   = "MyTRNG1";
TRNG1.$assign = "TRNG";

/**
 * Pinmux solution for unlocked pins/peripherals. This ensures that minor changes to the automatic solver in a future
 * version of the tool will not impact the pinmux you originally saw.  These lines can be completely deleted in order to
 * re-solve from scratch.
 */
Board.peripheral.$suggestSolution          = "DEBUGSS";
Board.peripheral.swclkPin.$suggestSolution = "PA20";
Board.peripheral.swdioPin.$suggestSolution = "PA19";
